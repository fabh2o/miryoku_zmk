// Copyright 2022 Manna Harbour
// https://github.com/manna-harbour/miryoku

#include "../miryoku/custom_config.h"
#include "../miryoku/mapping/42/corne.h"
#include "../miryoku/miryoku.dtsi"

// https://zmk.dev/docs/config#changing-devicetree-properties

// https://zmk.dev/docs/features/underglow#modifying-the-number-of-leds
// only underglow:   6
// all LEDs: 6+21 = 27
&led_strip {
    chain-length = <27>;
};

// https://nicekeyboards.com/docs/nice-view/getting-started#using-an-existing-oled-compatible-shield
// &gpio1 7 -> P01.07
// &gpio1 1 -> P01.01
&nice_view_spi {
    cs-gpios = <&gpio1 1 GPIO_ACTIVE_HIGH>;
};
